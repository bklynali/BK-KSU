## kernel/Kconfig
```kconfig
menu "BK-KSU"

config KSU
	tristate "BK-KSU function support"
	depends on KPROBES
	default y
	help
	  Enable kernel-level root privileges on Android System.
	  Requires CONFIG_KPROBES for kernel hooking support.
	  To compile as a module, choose M here: the
	  module will be called kernelsu.

config KSU_DEBUG
	bool "BK-KSU debug mode"
	depends on KSU
	default n
	help
	  Enable BK-KSU debug mode.

endmenu
```
